## Documentation/devicetree/bindings/reset/nxp,lpc1850-rgu.txt
```
NXP LPC1850  Reset Generation Unit (RGU)
========================================

Please also refer to reset.txt in this directory for common reset
controller binding usage.

Required properties:
- compatible: Should be "nxp,lpc1850-rgu"
- reg: register base and length
- clocks: phandle and clock specifier to RGU clocks
- clock-names: should contain "delay" and "reg"
- #reset-cells: should be 1

Refer to NXP LPC18xx or LPC43xx user manual for a description of the
reset signals and the connected block/peripheral.

Reset provider example:
rgu: reset-controller@40053000 {
	compatible = "nxp,lpc1850-rgu";
	reg = <0x40053000 0x1000>;
	clocks = <&cgu BASE_SAFE_CLK>, <&ccu1 CLK_CPU_BUS>;
	clock-names = "delay", "reg";
	#reset-cells = <1>;
};

Reset consumer example:
mac: ethernet@40010000 {
	compatible = "nxp,lpc1850-dwmac", "snps,dwmac-3.611", "snps,dwmac";
	reg = <0x40010000 0x2000>;
	interrupts = <5>;
	interrupt-names = "macirq";
	clocks = <&ccu1 CLK_CPU_ETHERNET>;
	clock-names = "stmmaceth";
	resets = <&rgu 22>;
	reset-names = "stmmaceth";
	status = "disabled";
};
```

## arch/arm/configs/lpc2k_defconfig
```kconfig
CONFIG_EXPERIMENTAL=y
# CONFIG_LOCALVERSION_AUTO is not set
CONFIG_TINY_RCU=y
# CONFIG_UTS_NS is not set
# CONFIG_PID_NS is not set
CONFIG_BLK_DEV_INITRD=y
# CONFIG_CC_OPTIMIZE_FOR_SIZE is not set
# CONFIG_COMPAT_BRK is not set
# CONFIG_LBDAF is not set
# CONFIG_BLK_DEV_BSG is not set
# CONFIG_IOSCHED_DEADLINE is not set
# CONFIG_IOSCHED_CFQ is not set
# CONFIG_MMU is not set
CONFIG_ARCH_LPC2K=y
CONFIG_MACH_EA2478DEVKIT=y
CONFIG_PROCESSOR_ID=0x41007700
CONFIG_NO_HZ=y
CONFIG_HIGH_RES_TIMERS=y
CONFIG_PREEMPT=y
CONFIG_AEABI=y
CONFIG_CMDLINE="root=/dev/ram initrd=0xa1a00000,4000k console=ttyS0,115200N8 debug rw earlyprintk"
CONFIG_BINFMT_FLAT=y
CONFIG_BINFMT_ZFLAT=y
CONFIG_BINFMT_SHARED_FLAT=y
# CONFIG_SUSPEND is not set
# CONFIG_PREVENT_FIRMWARE_BUILD is not set
# CONFIG_FIRMWARE_IN_KERNEL is not set
CONFIG_BLK_DEV_LOOP=y
CONFIG_BLK_DEV_RAM=y
# CONFIG_INPUT_MOUSEDEV_PSAUX is not set
# CONFIG_INPUT_KEYBOARD is not set
# CONFIG_INPUT_MOUSE is not set
# CONFIG_SERIO is not set
# CONFIG_LEGACY_PTYS is not set
# CONFIG_DEVKMEM is not set
CONFIG_SERIAL_8250=y
CONFIG_SERIAL_8250_CONSOLE=y
# CONFIG_HW_RANDOM is not set
CONFIG_SPI=y
CONFIG_SPI_PL022=y
# CONFIG_HWMON is not set
# CONFIG_MFD_SUPPORT is not set
# CONFIG_HID_SUPPORT is not set
# CONFIG_USB_SUPPORT is not set
CONFIG_MMC=y
CONFIG_MMC_ARMMMCI=y
# CONFIG_DNOTIFY is not set
# CONFIG_INOTIFY_USER is not set
CONFIG_CRAMFS=y
CONFIG_ROMFS_FS=y
CONFIG_MAGIC_SYSRQ=y
CONFIG_DEBUG_KERNEL=y
# CONFIG_FTRACE is not set
CONFIG_DEBUG_USER=y
CONFIG_DEBUG_ERRORS=y
CONFIG_DEBUG_LL=y
CONFIG_EARLY_PRINTK=y
```

## arch/arm/mach-lpc2k/Kconfig
```kconfig
if ARCH_LPC2K

comment "LPC2K machines"

config MACH_EA2478DEVKIT
	bool "Embedded Artists LPC2478 Developer's Kit"
	help
	  Say Y if you want the kernel to support the EmbeddedArtists
	  LPC2478 Developer's Kit. For more hardware details, see:
	  http://www.embeddedartists.com/products/kits/lpc2478_kit.php

endif
```

## sound/soc/nxp/Kconfig
```kconfig
config SND_SOC_NXP
	tristate "ASoC support for NXP SoCs"
	depends on COMPILE_TEST || ARCH_LPC18XX
	help
	  Say Y or M if you want to add support for codecs attached to
	  the NXP SoCs' Audio interfaces. You will also need to select
	  the audio interfaces to support below.

config SND_SOC_LPC32XX_I2S
	tristate "NXP LPC32xx I2S device driver"
	depends on OF && SND_SOC_NXP
	select SND_SOC_GENERIC_DMAENGINE_PCM
	help
	  Say Y or M if you want to add support for I2S driver for
	  NXP LPC32xx I2S device.
```
