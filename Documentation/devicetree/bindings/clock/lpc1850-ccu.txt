## Documentation/devicetree/bindings/clock/lpc1850-ccu.txt
```
* NXP LPC1850 Clock Control Unit (CCU)

Each CGU base clock has several clock branches which can be turned on
or off independently by the Clock Control Units CCU1 or CCU2. The
branch clocks are distributed between CCU1 and CCU2.

 - Above text taken from NXP LPC1850 User Manual.

This binding uses the common clock binding:
    Documentation/devicetree/bindings/clock/clock-bindings.txt

Required properties:
- compatible:
	Should be "nxp,lpc1850-ccu"
- reg:
	Shall define the base and range of the address space
	containing clock control registers
- #clock-cells:
	Shall have value <1>.  The permitted clock-specifier values
	are the branch clock names defined in table below.
- clocks:
	Shall contain a list of phandles for the base clocks routed
	from the CGU to the specific CCU. See mapping of base clocks
	and CCU in table below.

Which brach clocks that are available on the CCU depends on the
specific LPC part.

CCU1 branch clocks:
Base clock	Branch clock		Description
BASE_APB3_CLK	CLK_APB3_BUS		APB3 bus clock.
		CLK_APB3_I2C1		Clock to the I2C1 register interface
					and I2C1 peripheral clock.
		CLK_APB3_DAC		Clock to the DAC register interface.
		CLK_APB3_ADC0		Clock to the ADC0 register interface
					and ADC0 peripheral clock.
		CLK_APB3_ADC1		Clock to the ADC1 register interface
					and ADC1 peripheral clock.
		CLK_APB3_CAN0		Clock to the C_CAN0 register interface
					and C_CAN0 peripheral clock.
BASE_APB1_CLK	CLK_APB1_BUS		APB1 bus clock.
		CLK_APB1_MOTOCON_PWM	Clock to the PWM Motor control block and
					PWM Motor control peripheral clock.
		CLK_APB1_I2C0		Clock to the I2C0 register interface and
					I2C0 peripheral clock.
		CLK_APB1_I2S		Clock to the I2S0 and I2S1 register interfaces
					and I2S0 and I2S1 peripheral clock.
		CLK_APB1_CAN1		Clock to the C_CAN1 register interface and
					C_CAN1 peripheral clock.
BASE_SPIFI_CLK	CLK_SPIFI		Clock for the SPIFI SCKI clock input.
BASE_CPU_CLK	CLK_CPU_BUS		M4 bus clock.
		CLK_CPU_SPIFI		Clock to the SPIFI register interface.
		CLK_CPU_GPIO		Clock to the GPIO register interface
		CLK_CPU_LCD		Clock to the LCD register interface.
		CLK_CPU_ETHERNET	Clock to the Ethernet register interface.
		CLK_CPU_USB0		Clock to the USB0 register interface.
		CLK_CPU_EMC		Clock to the External memory controller.
		CLK_CPU_SDIO		Clock to the SD/MMC register interface.
		CLK_CPU_DMA		Clock to the DMA register interface.
		CLK_CPU_CORE		Clock to the Cortex-M core
		CLK_CPU_SCT		Clock to the SCT register interface.
		CLK_CPU_USB1		Clock to the USB1 register interface.
		CLK_CPU_EMC_DIV		Clock to the EMC with clock divider.
		CLK_CPU_FLASHA		Clock to the flash bank A.
		CLK_CPU_FLASHB		Clock to the flash bank B.
		CLK_CPU_M0APP		Clock to the M0APP coprocessor.
		CLK_CPU_ADCHS		Clock to the ADCHS.
		CLK_CPU_EEPROM		Clock to the EEPROM.
		CLK_CPU_WWDT		Clock to the WWDT register interface.
		CLK_CPU_UART0		Clock to the USART0 register interface.
		CLK_CPU_UART1		Clock to the UART1 register interface.
		CLK_CPU_SSP0		Clock to the SSP0 register interface.
		CLK_CPU_TIMER0		Clock to the timer0 register interface and
					timer0 peripheral clock.
		CLK_CPU_TIMER1		Clock to the timer1 register interface and
					timer1 peripheral clock.
		CLK_CPU_SCU		Clock to the System control unit register interface.
		CLK_CPU_CREG		Clock to the CREG register interface.
		CLK_CPU_RITIMER		Clock to the RI timer register interface and
					RI timer peripheral clock.
		CLK_CPU_UART2		Clock to the UART2 register interface.
		CLK_CPU_UART3		Clock to the UART3 register interface.
		CLK_CPU_TIMER2		Clock to the timer2 register interface and
					timer2 peripheral clock.
		CLK_CPU_TIMER3		Clock to the timer3 register interface and
					timer3 peripheral clock.
		CLK_CPU_SSP1		Clock to the SSP1 register interface.
		CLK_CPU_QEI		Clock to the QEI register interface and
					QEI peripheral clock.
BASE_PERIPH_CLK	CLK_PERIPH_BUS		Clock to the peripheral bus and the
					Cortex-M0 subsystem AHB multilayer matrix.
		CLK_PERIPH_CORE		Clock to the Cortex-M0 subsystem core.
		CLK_PERIPH_SGPIO	Clock to the SGPIO interface.
BASE_USB0_CLK	CLK_USB0		USB0 peripheral clock.
BASE_USB1_CLK	CLK_USB1		USB1 peripheral clock.
BASE_SPI_CLK	CLK_SPI			Clock to the SPI interface.
BASE_ADCHS_CLK	CLK_ADCHS		ADCHS clock.

CCU2 branch clocks:
BASE_AUDIO_CLK	CLK_AUDIO		Audio system (I2S) clock.
BASE_UART3_CLK	CLK_APB2_UART3		USART3 peripheral clock.
BASE_UART2_CLK	CLK_APB2_UART2		USART2 peripheral clock.
BASE_UART1_CLK	CLK_APB0_UART1		UART1 peripheral clock.
BASE_UART0_CLK	CLK_APB0_UART0		USART0 peripheral clock.
BASE_SSP1_CLK	CLK_APB2_SSP1		SSP1 peripheral clock.
BASE_SSP0_CLK	CLK_APB0_SSP0		SSP0 peripheral clock.
BASE_SDIO_CLK	CLK_SDIO		SD/MMC peripheral clock.

Not all branch clocks are available on all LPC parts. Check the user
manual for your specific part.

Note that CLK_M3_x and CLK_M4_x have been renamed to CLK_CPU_x here
be more generic since both LPC18xx (M3) and LPC43xx (M4) are
supported.


Example board file:

soc {
	ccu1: ccu@40051000 {
		compatible = "nxp,lpc1850-ccu";
		reg = <0x40051000 0x1000>;
		#clock-cells = <1>;
		clocks = <&cgu BASE_APB3_CLK>,   <&cgu BASE_APB1_CLK>,
			 <&cgu BASE_SPIFI_CLK>,  <&cgu BASE_CPU_CLK>,
			 <&cgu BASE_PERIPH_CLK>, <&cgu BASE_USB0_CLK>,
			 <&cgu BASE_USB1_CLK>,   <&cgu BASE_SPI_CLK>;
	};

	ccu2: ccu@40052000 {
		compatible = "nxp,lpc1850-ccu";
		reg = <0x40052000 0x1000>;
		#clock-cells = <1>;
		clocks = <&cgu BASE_AUDIO_CLK>, <&cgu BASE_UART3_CLK>,
			 <&cgu BASE_UART2_CLK>, <&cgu BASE_UART1_CLK>,
			 <&cgu BASE_UART0_CLK>, <&cgu BASE_SSP1_CLK>,
			 <&cgu BASE_SSP0_CLK>,  <&cgu BASE_SDIO_CLK>;
	};

	/* A user of CCU brach clocks */
	uart1: serial@40082000 {
		...
		clocks = <&ccu2 CLK_APB0_UART1>, <&ccu1 CLK_CPU_UART1>;
		...
	};
};
```

## Documentation/devicetree/bindings/dma/arm-pl08x.txt
```
* ARM PrimeCells PL080 and PL081 and derivatives DMA controller

Required properties:
- compatible: "arm,pl080", "arm,pl081", "arm,primecell"
- reg: Address range of the PL08x registers
- interrupt: The PL08x interrupt number
- clocks: The clock running the IP core clock
- clock-names: A list with one element with the name of the core clock
- lli-bus-interface-ahb1: if AHB master 1 is eligible for fetching LLIs
- lli-bus-interface-ahb2: if AHB master 2 is eligible for fetching LLIs
- mem-bus-interface-ahb1: if AHB master 1 is eligible for fetching memory contents
- mem-bus-interface-ahb2: if AHB master 2 is eligible for fetching memory contents
- #dma-cells: must be <3>

Optional properties:
- memcpy-burst-size: the size of the bursts for memcpy: 1, 4, 8, 16, 32
  64, 128 or 256 bytes are legal values
- memcpy-bus-width: the bus width used for memcpy: 8, 16 or 32 are legal
  values

Optional sub-nodes:
The slave transfer channels are assigned in consecutive order and
identified by one child node per channel, assuming a fixed-signal
per channel assignment and each with the following properties:

Required properties:
- signal: the name of the on-chip signal line handled by this channel
- bus-interface-ahb1 or bus-interface-ahb2: tells the driver which
  bus interface(s) that is eligible for this specific channel. At least
  one of the interfaces must be specified, it is perfectly legal to
  specify both if the hardware supports using either interface.

Clients
Required properties:
- dmas: Comma separated list of dma channel requests
- dma-names: Names of the aforementioned requested channels

Example:

dmac0: dma-controller@10130000 {
	compatible = "arm,pl080", "arm,primecell";
	reg = <0x10130000 0x1000>;
	interrupt-parent = <&vica>;
	interrupts = <15>;
	clocks = <&hclkdma0>;
	clock-names = "apb_pclk";
	lli-bus-interface-ahb1;
	lli-bus-interface-ahb2;
	mem-bus-interface-ahb2;
	memcpy-burst-size = <256>;
	memcpy-bus-width = <32>;
	#dma-cells = <1>;
	/* Assignments for the 32 channels */
	saa0@dmac0 {
		signal = "saa0";
		bus-interface-ahb1;
	};
	saa1@dmac0 {
		signal = "saa1";
		bus-interface-ahb1;
	};
	saa2@dmac0 {
		signal = "saa2";
		bus-interface-ahb1;
	};
	saa3@dmac0 {
		signal = "saa3";
		bus-interface-ahb1;
	};
	saa4@dmac0 {
		signal = "saa4";
		bus-interface-ahb1;
	};
	saa5@dmac0 {
		signal = "saa5";
		bus-interface-ahb1;
	};
	saa6@dmac0 {
		signal = "saa6";
		bus-interface-ahb1;
	};
	saa7@dmac0 {
		signal = "saa7";
		bus-interface-ahb1;
	};
	unused@dmac0 {
		signal = "unused";
		bus-interface-ahb1;
	};
	fir@dmac0 {
		signal = "firdatxrx";
		bus-interface-ahb1;
	};
	msp0rx@dmac0 {
		signal = "msp0rx";
		bus-interface-ahb1;
	};
	msp0tx@dmac0 {
		signal = "msp0tx";
		bus-interface-ahb1;
	};
	ssprx@dmac0 {
		signal = "ssprx";
		bus-interface-ahb1;
	};
	ssptx@dmac0 {
		signal = "ssptx";
		bus-interface-ahb1;
	};
	uart0rx@dmac0 {
		signal = "uart0rx";
		bus-interface-ahb1;
	};
	uart0tx@dmac0 {
		signal = "uart0tx";
		bus-interface-ahb1;
	};
	hsirxch0@dmac0 {
		signal = "hsirxch0";
		bus-interface-ahb1;
	};
	hsirxch1@dmac0 {
		signal = "hsirxch1";
		bus-interface-ahb1;
	};
	hsirxch2@dmac0 {
		signal = "hsirxch2";
		bus-interface-ahb1;
	};
	hsirxch3@dmac0 {
		signal = "hsirxch3";
		bus-interface-ahb1;
	};
	hsirxch4@dmac0 {
		signal = "hsirxch4";
		bus-interface-ahb1;
	};
	hsirxch5@dmac0 {
		signal = "hsirxch5";
		bus-interface-ahb1;
	};
	hsirxch6@dmac0 {
		signal = "hsirxch6";
		bus-interface-ahb1;
	};
	hsirxch7@dmac0 {
		signal = "hsirxch7";
		bus-interface-ahb1;
	};
	hsitxch0@dmac0 {
		signal = "hsitxch0";
		bus-interface-ahb1;
	};
	hsitxch1@dmac0 {
		signal = "hsitxch1";
		bus-interface-ahb1;
	};
	hsitxch2@dmac0 {
		signal = "hsitxch2";
		bus-interface-ahb1;
	};
	hsitxch3@dmac0 {
		signal = "hsitxch3";
		bus-interface-ahb1;
	};
	hsitxch4@dmac0 {
		signal = "hsitxch4";
		bus-interface-ahb1;
	};
	hsitxch5@dmac0 {
		signal = "hsitxch5";
		bus-interface-ahb1;
	};
	hsitxch6@dmac0 {
		signal = "hsitxch6";
		bus-interface-ahb1;
	};
	hsitxch7@dmac0 {
		signal = "hsitxch7";
		bus-interface-ahb1;
	};
};
```

## Documentation/devicetree/bindings/firmware/nxp,boot-rom.txt
```
* NXP LPC boot ROM

NXP LPC microcontrollers contains a boot ROM used to retrieve part information
and access internal Flash memory and OTP memory. Note that the Flash API is not
available on Flashless devices. Availability of the Flash API can determined at
run-time by reading the 'CHIP ID' register in CREG.

Required properties:
- compatible: must contain the following: "nxp,lpc1850-boot-rom".
- reg: physical base address of the ROM and length of memory mapped region.
- syscon: handle to NXP CREG (Configuration Registers) syscon block.
- nvmem-cells: = handle to OTP memory cell which contain the part ID.
- nvmem-cell-names: must contain "PartID".

Example:
boot_rom: firmware@10400000 {
	compatible = "nxp,lpc1850-boot-rom";
	reg = <0x10400000 0x10000>;
	syscon = <&creg>;
	nvmem-cells = <&part_id>;
	nvmem-cell-names = "PartID";
};
```

## Documentation/devicetree/bindings/gpio/nxp,lpc1850-gpio.txt
```
NXP LPC18xx/43xx GPIO controller Device Tree Bindings
-----------------------------------------------------

Required properties:
- compatible		: Should be "nxp,lpc1850-gpio"
- reg			: Address and length of the register set for the device
- clocks		: Clock specifier (see clock bindings for details)
- gpio-controller	: Marks the device node as a GPIO controller.
- #gpio-cells 		: Should be two
			  - First cell is the GPIO line number
			  - Second cell is used to specify polarity

Optional properties:
- gpio-ranges		: Mapping between GPIO and logic pin for pinctrl

Examples:
gpio: gpio@400f4000 {
	compatible = "nxp,lpc1850-gpio";
	reg = <0x400f4000 0x4000>;
	clocks = <&ccu1 CLK_CPU_GPIO>;
	gpio-controller;
	#gpio-cells = <2>;
}
```

## Documentation/devicetree/bindings/interrupt-controller/nxp,lpc1850-gpio-pint.txt
```
NXP LPC18xx/43xx GPIO Pin Interrupt (PINT) controller

Required properties:

- compatible : should be "nxp,lpc1850-gpio-pint".
- reg : Specifies base physical address and size of the registers.
- interrupt-controller : Identifies the node as an interrupt controller
- #interrupt-cells : Specifies the number of cells needed to encode an
  interrupt source. The value shall be 2.
- interrupts : Must contain the interrupt numbers from the parent controller.
	       This defines the mapping between the controllers where the first
	       interrupt is mapped to pint hwirq 0 and so on. Which interrupts
	       that are connected to where and the number of is device specific.
	       For lpc1850 the mapping is 32 33 34 35 36 37 38 39 (8 in total).
- clocks: Must contain a reference to the functional clock.

Example:

pint: interrupt-controller@40087000 {
	compatible = "nxp,lpc1850-gpio-pint";
	reg = <0x40087000 0x1000>;
	interrupt-controller;
	#interrupt-cells = <2>;
	interrupts = <32 33 34 35 36 37 38 39>;
	clocks = <&ccu1 CLK_CPU_GPIO>;
};
```

## Documentation/devicetree/bindings/leds/leds-pca9532.txt
```
*NXP - pca9532 PWM LED Driver

The PCA9532 family is SMBus I/O expander optimized for dimming LEDs.
The PWM support 256 steps.

Required properties:
	- compatible:
		"nxp,pca9530"
		"nxp,pca9531"
		"nxp,pca9532"
		"nxp,pca9533"
	- reg -  I2C slave address

Each led is represented as a sub-node of the nxp,pca9530.

Optional sub-node properties:
	- label: see Documentation/devicetree/bindings/leds/common.txt
	- type: Output configuration, see dt-bindings/leds/leds-pca9532.h (default NONE)
	- reg : number of LED line (could be from 0 to 1 in pca9630, 0 to 4 in pca9533,
		0 to 7 in pca9631, or 0 to 15 in pca9632)
	- linux,default-trigger: see Documentation/devicetree/bindings/leds/common.txt

Example:
  #include <dt-bindings/leds/leds-pca9532.h>

  leds: pca9530@60 {
    compatible = "nxp,pca9530";
    #address-cells = <1>;
    #size-cells = <0>;
    reg = <0x60>;

    red-power@0 {
      label = "pca:red:power";
      type = <PCA9532_TYPE_LED>;
      reg = <0>;
    };
    green-power@1 {
      label = "pca:green:power";
      type = <PCA9532_TYPE_LED>;
      reg = <1>;
    };
  };

For more product information please see the link below:
http://nxp.com/documents/data_sheet/PCA9532.pdf
```

## Documentation/devicetree/bindings/phy/nxp,lpc1850-usb-otg-phy.txt
```
NXP LPC18xx/43xx internal USB OTG PHY binding
---------------------------------------------

This file contains documentation for the internal USB OTG PHY found
in NXP LPC18xx and LPC43xx SoCs.

Required properties:
- compatible	: must be "nxp,lpc1850-usb-otg-phy"
- clocks	: must be exactly one entry
See: Documentation/devicetree/bindings/clock/clock-bindings.txt
- #phy-cells	: must be 0 for this phy
See: Documentation/devicetree/bindings/phy/phy-bindings.txt

Example:
usb0_otg_phy: usb0-otg-phy {
	compatible = "nxp,lpc1850-usb-otg-phy";
	clocks = <&ccu1 CLK_USB0>;
	#phy-cells = <0>;
};
```

## Documentation/devicetree/bindings/remoteproc/lpc43xx-rproc.txt
```
NXP LPC43xx Co-Processor Bindings
----------------------------------------

This binding provides support for the M0 cores processors
found on NXP LPC43xx SoCs.

Required properties:
- compatible		Should be one of:
				"nxp,lpc4350-rproc"
				"nxp,lpc4370-rproc"
- interrupts		Interrupt for inter processor communication
- resets		Reset lines (See: ../reset/reset.txt)
- clocks		Clock for co-processor (See: ../clock/clock-bindings.txt)

Example:
m0app {
	compatible = "nxp,lpc4350-rproc"
	interrupts = <1>;
	resets = <&rgu 56>;
	clocks = <&ccu1 CLK_CPU_M0APP>;
};
```
